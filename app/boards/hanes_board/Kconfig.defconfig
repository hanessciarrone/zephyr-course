## app/boards/hanes_board/Kconfig.defconfig
```kconfig
# NUCLEO-144 F429ZI board configuration

# Copyright (c) 2017 Linaro Limited
# SPDX-License-Identifier: Apache-2.0

if BOARD_HANES_BOARD

if NETWORKING

config NET_L2_ETHERNET
	default y

endif # NETWORKING

endif # BOARD_HANES_BOARD
```

## app/boards/hanes_board/board.yml
```yaml
board:
    name: hanes_board
    full_name: Nucleo F429ZI
    vendor: zephyr-course
    socs:
        - name: stm32f429xx
```

## app/boards/scratch_board/board.yml
```yaml
board:
    name: scratch_board
    full_name: Scratch Board
    vendor: zephyr-course
    socs:
        - name: stm32f429xx
```

## app/drivers/subsys/hanes_driver/Kconfig
```kconfig
menuconfig HANES_DRIVER
    bool "Enable Hanes LED sensor driver"
    depends on DT_HAS_HANES_DRIVER_ENABLED
    select GPIO
    select SENSOR
    help
        Enable the simple GPIO-backed LED sensor driver used to toggle LD2.

    if HANES_DRIVER
        config HANES_DRIVER_MESSAGE_MAX_LEN
            int "Maximum message length"
            default 64
            help
                Maximum message length (Please note it is the length of an array of char)
    endif # HANES_DRIVER
```

## twister-out/native_sim_native/host/homework.unit.ring_buf/Kconfig/boards/Kconfig.defconfig
```kconfig
# Load Zephyr board defconfig descriptions.
osource "/home/hanes/zephyr-course/zephyrproject/deps/zephyr/boards/native/native_sim/Kconfig.defconfig"
```

## twister-out/native_sim_native/host/homework.unit.ring_buf/Kconfig/boards/Kconfig.native_sim
```kconfig
# Load board Kconfig descriptions.
osource "/home/hanes/zephyr-course/zephyrproject/deps/zephyr/boards/native/native_sim/Kconfig.native_sim"
```

## twister-out/native_sim_native/host/homework.unit.ring_buf/Kconfig/soc/Kconfig
```kconfig
# Load Zephyr SoC Kconfig descriptions.
osource "/home/hanes/zephyr-course/zephyrproject/deps/zephyr/soc/xlnx/zynqmp/Kconfig"
osource "/home/hanes/zephyr-course/zephyrproject/deps/zephyr/soc/xlnx/zynq7000/Kconfig"
osource "/home/hanes/zephyr-course/zephyrproject/deps/zephyr/soc/xlnx/versalnet/Kconfig"
osource "/home/hanes/zephyr-course/zephyrproject/deps/zephyr/soc/xlnx/versal2/Kconfig"
osource "/home/hanes/zephyr-course/zephyrproject/deps/zephyr/soc/xen/Kconfig"
osource "/home/hanes/zephyr-course/zephyrproject/deps/zephyr/soc/wch/ch32v/Kconfig"
osource "/home/hanes/zephyr-course/zephyrproject/deps/zephyr/soc/ti/simplelink/Kconfig"
osource "/home/hanes/zephyr-course/zephyrproject/deps/zephyr/soc/ti/mspm0/Kconfig"
osource "/home/hanes/zephyr-course/zephyrproject/deps/zephyr/soc/ti/lm3s6965/Kconfig"
osource "/home/hanes/zephyr-course/zephyrproject/deps/zephyr/soc/ti/k3/Kconfig"
osource "/home/hanes/zephyr-course/zephyrproject/deps/zephyr/soc/telink/tlsr/Kconfig"
osource "/home/hanes/zephyr-course/zephyrproject/deps/zephyr/soc/starfive/jh71xx/Kconfig"
osource "/home/hanes/zephyr-course/zephyrproject/deps/zephyr/soc/st/stm32/Kconfig"
osource "/home/hanes/zephyr-course/zephyrproject/deps/zephyr/soc/snps/qemu_arc/Kconfig"
osource "/home/hanes/zephyr-course/zephyrproject/deps/zephyr/soc/snps/nsim/arc_v/Kconfig"
osource "/home/hanes/zephyr-course/zephyrproject/deps/zephyr/soc/snps/nsim/arc_classic/Kconfig"
osource "/home/hanes/zephyr-course/zephyrproject/deps/zephyr/soc/snps/hsdk4xd/Kconfig"
osource "/home/hanes/zephyr-course/zephyrproject/deps/zephyr/soc/snps/hsdk/Kconfig"
osource "/home/hanes/zephyr-course/zephyrproject/deps/zephyr/soc/snps/emsk/Kconfig"
osource "/home/hanes/zephyr-course/zephyrproject/deps/zephyr/soc/snps/emsdp/Kconfig"
osource "/home/hanes/zephyr-course/zephyrproject/deps/zephyr/soc/snps/arc_iot/Kconfig"
osource "/home/hanes/zephyr-course/zephyrproject/deps/zephyr/soc/silabs/Kconfig"
osource "/home/hanes/zephyr-course/zephyrproject/deps/zephyr/soc/sifive/sifive_freedom/Kconfig"
osource "/home/hanes/zephyr-course/zephyrproject/deps/zephyr/soc/sensry/Kconfig"
osource "/home/hanes/zephyr-course/zephyrproject/deps/zephyr/soc/rockchip/Kconfig"
osource "/home/hanes/zephyr-course/zephyrproject/deps/zephyr/soc/renode/riscv_virtual/Kconfig"
osource "/home/hanes/zephyr-course/zephyrproject/deps/zephyr/soc/renode/cortex_r8_virtual/Kconfig"
osource "/home/hanes/zephyr-course/zephyrproject/deps/zephyr/soc/renesas/smartbond/Kconfig"
osource "/home/hanes/zephyr-course/zephyrproject/deps/zephyr/soc/renesas/rz/Kconfig"
osource "/home/hanes/zephyr-course/zephyrproject/deps/zephyr/soc/renesas/rx/Kconfig"
osource "/home/hanes/zephyr-course/zephyrproject/deps/zephyr/soc/renesas/rcar/Kconfig"
osource "/home/hanes/zephyr-course/zephyrproject/deps/zephyr/soc/renesas/ra/Kconfig"
osource "/home/hanes/zephyr-course/zephyrproject/deps/zephyr/soc/realtek/ec/Kconfig"
osource "/home/hanes/zephyr-course/zephyrproject/deps/zephyr/soc/raspberrypi/rpi_pico/Kconfig"
osource "/home/hanes/zephyr-course/zephyrproject/deps/zephyr/soc/quicklogic/eos_s3/Kconfig"
osource "/home/hanes/zephyr-course/zephyrproject/deps/zephyr/soc/qemu/virt_riscv/Kconfig"
osource "/home/hanes/zephyr-course/zephyrproject/deps/zephyr/soc/qemu/malta/Kconfig"
osource "/home/hanes/zephyr-course/zephyrproject/deps/zephyr/soc/openisa/rv32m1/Kconfig"
osource "/home/hanes/zephyr-course/zephyrproject/deps/zephyr/soc/openhwgroup/cva6/Kconfig"
osource "/home/hanes/zephyr-course/zephyrproject/deps/zephyr/soc/oct/osd32mp15x/Kconfig"
osource "/home/hanes/zephyr-course/zephyrproject/deps/zephyr/soc/nxp/s32/Kconfig"
osource "/home/hanes/zephyr-course/zephyrproject/deps/zephyr/soc/nxp/rw/Kconfig"
osource "/home/hanes/zephyr-course/zephyrproject/deps/zephyr/soc/nxp/mcx/Kconfig"
osource "/home/hanes/zephyr-course/zephyrproject/deps/zephyr/soc/nxp/lpc/Kconfig"
osource "/home/hanes/zephyr-course/zephyrproject/deps/zephyr/soc/nxp/layerscape/Kconfig"
osource "/home/hanes/zephyr-course/zephyrproject/deps/zephyr/soc/nxp/kinetis/Kconfig"
osource "/home/hanes/zephyr-course/zephyrproject/deps/zephyr/soc/nxp/imxrt/Kconfig"
osource "/home/hanes/zephyr-course/zephyrproject/deps/zephyr/soc/nxp/imx/Kconfig"
osource "/home/hanes/zephyr-course/zephyrproject/deps/zephyr/soc/nuvoton/numicro/Kconfig"
osource "/home/hanes/zephyr-course/zephyrproject/deps/zephyr/soc/nuvoton/numaker/Kconfig"
osource "/home/hanes/zephyr-course/zephyrproject/deps/zephyr/soc/nuvoton/npcx/Kconfig"
osource "/home/hanes/zephyr-course/zephyrproject/deps/zephyr/soc/nuvoton/npcm/Kconfig"
osource "/home/hanes/zephyr-course/zephyrproject/deps/zephyr/soc/nordic/Kconfig"
osource "/home/hanes/zephyr-course/zephyrproject/deps/zephyr/soc/neorv32/Kconfig"
osource "/home/hanes/zephyr-course/zephyrproject/deps/zephyr/soc/native/inf_clock/Kconfig"
osource "/home/hanes/zephyr-course/zephyrproject/deps/zephyr/soc/microchip/sam/Kconfig"
osource "/home/hanes/zephyr-course/zephyrproject/deps/zephyr/soc/microchip/miv/Kconfig"
osource "/home/hanes/zephyr-course/zephyrproject/deps/zephyr/soc/microchip/mec/Kconfig"
osource "/home/hanes/zephyr-course/zephyrproject/deps/zephyr/soc/mediatek/mt8xxx/Kconfig"
osource "/home/hanes/zephyr-course/zephyrproject/deps/zephyr/soc/lowrisc/opentitan/Kconfig"
osource "/home/hanes/zephyr-course/zephyrproject/deps/zephyr/soc/litex/litex_vexriscv/Kconfig"
osource "/home/hanes/zephyr-course/zephyrproject/deps/zephyr/soc/ite/ec/Kconfig"
osource "/home/hanes/zephyr-course/zephyrproject/deps/zephyr/soc/intel/raptor_lake/Kconfig"
osource "/home/hanes/zephyr-course/zephyrproject/deps/zephyr/soc/intel/lakemont/Kconfig"
osource "/home/hanes/zephyr-course/zephyrproject/deps/zephyr/soc/intel/intel_socfpga_std/Kconfig"
osource "/home/hanes/zephyr-course/zephyrproject/deps/zephyr/soc/intel/intel_socfpga/Kconfig"
osource "/home/hanes/zephyr-course/zephyrproject/deps/zephyr/soc/intel/intel_niosv/Kconfig"
osource "/home/hanes/zephyr-course/zephyrproject/deps/zephyr/soc/intel/intel_ish/Kconfig"
osource "/home/hanes/zephyr-course/zephyrproject/deps/zephyr/soc/intel/intel_adsp/Kconfig"
osource "/home/hanes/zephyr-course/zephyrproject/deps/zephyr/soc/intel/elkhart_lake/Kconfig"
osource "/home/hanes/zephyr-course/zephyrproject/deps/zephyr/soc/intel/atom/Kconfig"
osource "/home/hanes/zephyr-course/zephyrproject/deps/zephyr/soc/intel/apollo_lake/Kconfig"
osource "/home/hanes/zephyr-course/zephyrproject/deps/zephyr/soc/intel/alder_lake/Kconfig"
osource "/home/hanes/zephyr-course/zephyrproject/deps/zephyr/soc/infineon/cat3/Kconfig"
osource "/home/hanes/zephyr-course/zephyrproject/deps/zephyr/soc/infineon/cat1c/Kconfig"
osource "/home/hanes/zephyr-course/zephyrproject/deps/zephyr/soc/infineon/cat1b/Kconfig"
osource "/home/hanes/zephyr-course/zephyrproject/deps/zephyr/soc/infineon/cat1a/Kconfig"
osource "/home/hanes/zephyr-course/zephyrproject/deps/zephyr/soc/gd/gd32/Kconfig"
osource "/home/hanes/zephyr-course/zephyrproject/deps/zephyr/soc/gaisler/leon3/Kconfig"
osource "/home/hanes/zephyr-course/zephyrproject/deps/zephyr/soc/gaisler/gr716a/Kconfig"
osource "/home/hanes/zephyr-course/zephyrproject/deps/zephyr/soc/espressif/Kconfig"
osource "/home/hanes/zephyr-course/zephyrproject/deps/zephyr/soc/ene/kb1200/Kconfig"
osource "/home/hanes/zephyr-course/zephyrproject/deps/zephyr/soc/ene/kb106x/Kconfig"
osource "/home/hanes/zephyr-course/zephyrproject/deps/zephyr/soc/efinix/sapphire/Kconfig"
osource "/home/hanes/zephyr-course/zephyrproject/deps/zephyr/soc/cdns/xtensa_sample_controller/Kconfig"
osource "/home/hanes/zephyr-course/zephyrproject/deps/zephyr/soc/cdns/sample_controller32/Kconfig"
osource "/home/hanes/zephyr-course/zephyrproject/deps/zephyr/soc/cdns/dc233c/Kconfig"
osource "/home/hanes/zephyr-course/zephyrproject/deps/zephyr/soc/brcm/bcmvk/Kconfig"
osource "/home/hanes/zephyr-course/zephyrproject/deps/zephyr/soc/brcm/bcm2712/Kconfig"
osource "/home/hanes/zephyr-course/zephyrproject/deps/zephyr/soc/brcm/bcm2711/Kconfig"
osource "/home/hanes/zephyr-course/zephyrproject/deps/zephyr/soc/bflb/Kconfig"
osource "/home/hanes/zephyr-course/zephyrproject/deps/zephyr/soc/atmel/sam0/Kconfig"
osource "/home/hanes/zephyr-course/zephyrproject/deps/zephyr/soc/atmel/sam/Kconfig"
osource "/home/hanes/zephyr-course/zephyrproject/deps/zephyr/soc/aspeed/Kconfig"
osource "/home/hanes/zephyr-course/zephyrproject/deps/zephyr/soc/arm/Kconfig"
osource "/home/hanes/zephyr-course/zephyrproject/deps/zephyr/soc/arm/beetle/Kconfig"
osource "/home/hanes/zephyr-course/zephyrproject/deps/zephyr/soc/antmicro/myra/Kconfig"
osource "/home/hanes/zephyr-course/zephyrproject/deps/zephyr/soc/andestech/Kconfig"
osource "/home/hanes/zephyr-course/zephyrproject/deps/zephyr/soc/amd/acp_6_0/Kconfig"
osource "/home/hanes/zephyr-course/zephyrproject/deps/zephyr/soc/ambiq/Kconfig"
osource "/home/hanes/zephyr-course/zephyrproject/deps/zephyr/soc/aesc/Kconfig"
osource "/home/hanes/zephyr-course/zephyrproject/deps/zephyr/soc/adi/max32/Kconfig"
```
